## configs/tbx306x_defconfig
```kconfig
CONFIG_COMPRESS_GZIP=y
CONFIG_UART_DEBUG=n
CONFIG_SIMPLE_FB=y
CONFIG_MT6765=y
CONFIG_LENOVO_TBX306X=y
CONFIG_TEXT_BASE=0x40080000
CONFIG_RAMDISK_ENTRY=0x51b00000
CONFIG_PAYLOAD_ENTRY=0x45000000
```
